## conf/bblayers.conf.sample
```bitbake
# vim: ft=bitbake
# LAYER_CONF_VERSION is increased each time build/conf/bblayers.conf
# changes incompatibly
LCONF_VERSION = "7"

BBPATH = "${TOPDIR}"
BBFILES ?= ""

TSROOT = "##TSROOT##"

BBLAYERS_NON_REMOVABLE ?= "##OEROOT##/meta"

# Base Layer
BBLAYERS ?= "##OEROOT##/meta"

# Extended OE layers
BBLAYERS =+ "${TSROOT}/meta-openembedded/meta-oe"
BBLAYERS =+ "${TSROOT}/meta-openembedded/meta-filesystems"
BBLAYERS =+ "${TSROOT}/meta-openembedded/meta-networking"
BBLAYERS =+ "${TSROOT}/meta-openembedded/meta-python"
BBLAYERS =+ "${TSROOT}/meta-yocto/meta-yocto-bsp"

# Wild Layers
BBLAYERS =+ "${TSROOT}/meta-wild-common"
BBLAYERS =+ "${TSROOT}/meta-towelstick"
```

## conf/distro/tstick.conf
```bitbake
# Towel Stick distro configuration

require conf/distro/wild-generic.conf
require conf/distro/include/no-graphics.inc

DISTRO_NAME = "TowelStick"
DISTRO_VERSION = "1.0"

# based on DISTRO_FEATURES_DEFAULT, minus some things
DISTRO_FEATURES = "acl argp bluetooth ext2 irda largefile usbhost wifi xattr nfs pci ${DISTRO_FEATURES_LIBC}"
# extra things I want
DISTRO_FEATURES += "usrmerge ld-is-gold"

PREFERRED_PROVIDER_virtual/kernel = "linux-mainline"
PREFERRED_VERSION_linux-mainline ?= "4.19%"

VIRTUAL-RUNTIME_base-utils = "coreutils"
VIRTUAL-RUNTIME_base-utils-hwclock = "util-linux-hwclock"
PREFERRED_PROVIDER_virtual/base-utils = "coreutils"

# mask java buildhack bbappends to avoid warnings
BBMASK .= "|meta-wild-common/recipes-buildhacks/(cacao|icedtea|openjdk)/[\w.-]+\.bbappend"
```

## conf/distro/wildzilla.conf
```bitbake
#####################################
# wildzilla distro configuration
#####################################

#### System Configuration ####
TCLIBCAPPEND = ""

#### Kernel Configuration ####
PREFERRED_PROVIDER_virtual/kernel = "linux-yocto"
PREFERRED_VERSION_linux-yocto = "4.8%"

#### Distro Configuration ####
DISTRO_FEATURES_append = " systemd libc-locales libc-charsets libc-locale-code"
DISTRO_FEATURES_remove = "x11"
DISTRO_FEATURES_BACKFILL_CONSIDERED = "sysvinit pulseaudio"
VIRTUAL-RUNTIME_init_manager = "systemd"
VIRTUAL-RUNTIME_login_manager = "systemd"
VIRTUAL-RUNTIME_initscripts = "systemd-compat-units"
GLIBC_GENERATE_LOCALES = "en_US.UTF-8"
IMAGE_LINGUAS = "en-us"

USE_DEVFS = "1"
VIRTUAL-RUNTIME_dev_manager = "systemd"

#### Image Configuration ####
IMAGE_FSTYPES = "ext4 squashfs-xz tar.xz"
```

## conf/layer.conf
```bitbake
#
# meta-towelstick
#

BBPATH .= ":${LAYERDIR}"

BBFILES += "${LAYERDIR}/recipes*/*/*.bb \
            ${LAYERDIR}/recipes*/*/*.bbappend"

BBFILE_COLLECTIONS += "tstick"
BBFILE_PATTERN_tstick := "^${LAYERDIR}/"
BBFILE_PRIORITY_tstick = "11"
LAYERSERIES_COMPAT_tstick = "sumo thud warrior"

LAYERDEPENDS_tstick = "yoctobsp wild-common"
LICENSE_PATH += "${LAYERDIR}/custom-licenses"
```

## conf/machine/include/tune-core2-generic.inc
```bitbake
# Like oe-core's core2-64 tune but with '-march=core2 -mtune=generic' rather than '-march=core2 -mtune=core2'

TUNEVALID[core2-generic] = "Enable core2 architecture with generic optimizations"
TUNE_CCARGS .= "${@bb.utils.contains('TUNE_FEATURES', 'core2-generic', ' -march=core2 -mtune=generic -msse3 -mfpmath=sse', '', d)}"

AVAILTUNES += "core2-64-generic"
TUNE_FEATURES_tune-core2-64-generic = "${TUNE_FEATURES_tune-x86-64} core2-generic"
BASE_LIB_tune-core2-64-generic = "lib64"
TUNE_PKGARCH_tune-core2-64-generic = "core2-64"
PACKAGE_EXTRA_ARCHS_tune-core2-64-generic = "${PACKAGE_EXTRA_ARCHS_tune-x86-64} core2-64"
QEMU_EXTRAOPTIONS_core2-64-generic = " -cpu core2duo"
```

## conf/machine/tstickx86-64.conf
```bitbake
# variant of meta-yocto's genericx86-64 machine with the core2-64-generic tune
require conf/machine/genericx86-64.conf
require conf/machine/include/tune-core2-generic.inc

DEFAULTTUNE = "core2-64-generic"
```
